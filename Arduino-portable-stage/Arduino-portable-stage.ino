//include
#include "Keyboard.h"
#include "ConsumerKeyboard.h"
#include <Adafruit_NeoPixel.h>
#include <Adafruit_PWMServoDriver.h>
#include <Servo.h>
// #include <Arduino_FreeRTOS.h>
#include "WiFiS3.h"

//--Network Decleartion--//
char ssid[] = "SSID";
char pass[] = "PASS";
int status = WL_IDLE_STATUS;
WiFiServer server(80);

//--Hardware Decleartion--//
#define BUTTON_PIN 8
#define LED_PIN 6
#define LED_COUNT 4
Adafruit_NeoPixel strip(LED_COUNT, LED_PIN, NEO_GRB + NEO_KHZ800);
#define MAX 255  //brightness

const int ledIndex[] = {3,2,1,0};

Adafruit_PWMServoDriver pwm = Adafruit_PWMServoDriver(0x40);

//duty x/4096 = 50hz|20ms 0   1   2   3   4   5   6   7
const int servo_pulse_min[] = {282,293,287,302,307,317,327,307};
const int servo_pulse_mid[] = {355,365,360,375,380,390,400,380};
const int servo_pulse_max[] = {428,438,433,448,453,463,473,453};
#define SERVO_MIN_ANGLE 59
#define SERVO_MAX_ANGLE 121

//OL,CL,CR,OR
const int servoX[] = { 0, 1, 2, 3 };   //{ 7, 7, 7, 7 };   横
const int servoY[] = { 4, 5, 6, 7 };  //{ 7, 7, 7, 7 };  奥

//--Preset Data Decleartion--//
struct Rgb {
  uint8_t r;
  uint8_t g;
  uint8_t b;
};

const Rgb holoColors[] = {
  { 255, 255, 255 },  // 0: WHITE
  { 255, 1, 0 },      // 1: RED
  { 255, 164, 0 },    // 2: ORANGE
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  { 0, 0, 0 },  // 12: SKIPPED (Placeholder BLACK)

  // Interpolated colors (13-60)
  { 255, 204, 204 },  // 13 // Between 0 (WHITE) and 1 (RED)
  { 255, 153, 153 },  // 14
  { 255, 102, 102 },  // 15
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  { 255, 241, 250 },  // 60
  // Remaining colors to fill 64 slots (61-63) - Placeholder BLACK
  { 0, 0, 0 },  // 61
  { 0, 0, 0 },  // 62
  { 0, 0, 0 }   // 63
};

//PATTERN DATA
const uint64_t light_frame_data[] PROGMEM = {
    0006001060020600306004ULL,
    0006001060020600306004ULL,
    000601206012ULL,
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    00ULL,
    00ULL
};
#define ACTUAL_SIZE_OF_DATA 677
//data start line: 111 (line - 110 = endframe)


const uint64_t servo_frame_data[] PROGMEM = {
    0040011400124001340014ULL,
    0040051400524005340054ULL,
    0040061400624006340064ULL,
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    00ULL,
    00ULL
};
#define ACTUAL_SIZE_OF_SERVO_DATA 677

//--System Basic Declaration--//

bool isSystemBooted = false;  //boot (light maintenance mode)

//FRAME COUNT
#define ENDFRAME 675

//config
#define FRAME_RATE 46875  //per us
// #define FRAME_RATE 47  //per ms
// #define GRAD_FRAME 80  //per frame
#define GRAD_FRAME 60     //per frame
#define SERVO_GRAD_INT 2  //for each grad frame
#define PLAY_DELAY 440    //ms, VLC:490, Google Gallary:440

//--Functions--//
void setServo(int pin, int angle){
  int setPulse = 0;
  if(angle == 90){
    setPulse = servo_pulse_mid[pin];
  }else if(angle < 59){//-31
    setPulse = servo_pulse_min[pin];
  }else if(angle > 121){//+31
    setPulse = servo_pulse_max[pin];
  }else{
    setPulse = map(angle, SERVO_MIN_ANGLE, SERVO_MAX_ANGLE, servo_pulse_min[pin], servo_pulse_max[pin]);
  }
  pwm.setPWM(pin, 0, setPulse);
}

void initLight(int except) {  //if not except, expect -1
  for (int i = 0; i < LED_COUNT; i++) {
    if (i == except) continue;
    strip.setPixelColor(ledIndex[i], strip.Color(0, 0, 0));
  }
  strip.show();
}

void initServo(int except) {  //if not except, expect -1
  for (int i = 0; i < LED_COUNT; i++) {
    if (i == except) continue;
    setServo(servoX[i],90);
    setServo(servoY[i],90);
  }
  isSystemBooted = true;
}

void foldServo() {
  pwm.setPWM(servoX[0], 0, 560); //0 OL_X
  pwm.setPWM(servoX[3], 0, 180); //3 OR_X
  delay(10);
  pwm.setPWM(servoY[0], 0, 530); //4 OL_Y
  pwm.setPWM(servoY[3], 0, 230); //7 OR_Y
  pwm.setPWM(servoX[1], 0, 365); //1 CL_X
  pwm.setPWM(servoY[1], 0, 650); //5 CL_Y
  pwm.setPWM(servoX[2], 0, 360); //2 CR_X
  pwm.setPWM(servoY[2], 0, 130); //6 CR_Y

  isSystemBooted = false;
}

void bitServo() {  // the half of this made by Gemini
  initServo(-1);
  for (int t_deg = 0; t_deg <= 360; t_deg++) {
    float t_rad = t_deg * M_PI / 180.0;
    int angleX = 90 + 31 * cos(t_rad);
    int angleY = 90 + 31 * sin(t_rad);

    for (int i = 0; i < LED_COUNT; i++) {
      setServo(servoX[i],angleX);
    }
    setServo(servoY[0],angleY);
    setServo(servoY[1],angleY);
    setServo(servoY[2],180 - angleY);
    setServo(servoY[3],180 - angleY);
    delay(2);
  }
  initServo(-1);
}

void bootdownAnimation(bool isbooting){
  if (isbooting) {
    //servo
    initServo(-1);
    //light animation
    strip.setPixelColor(ledIndex[1], strip.Color(holoColors[7].r, holoColors[7].g, holoColors[7].b));
    initLight(1);
    delay(500);
    strip.setPixelColor(ledIndex[2], strip.Color(holoColors[2].r, holoColors[2].g, holoColors[2].b));
    initLight(2);
    delay(500);
    strip.setPixelColor(ledIndex[0], strip.Color(holoColors[10].r, holoColors[10].g, holoColors[10].b));
    initLight(0);
    delay(500);
    strip.setPixelColor(ledIndex[3], strip.Color(holoColors[3].r, holoColors[3].g, holoColors[3].b));
    initLight(3);
    delay(500);
    bitServo();
    delay(500);
    for (int i = 0; i < LED_COUNT; i++) {
      strip.setPixelColor(ledIndex[i], strip.Color(255, 255, 255));
    }
    strip.show();
    delay(500);
    initLight(-1);
  } else {
    //light animation
    for (int i = 0; i < LED_COUNT; i++) {
      strip.setPixelColor(ledIndex[i], strip.Color(255, 255, 255));
    }
    strip.show();
    delay(500);
    strip.setPixelColor(ledIndex[3], strip.Color(holoColors[3].r, holoColors[3].g, holoColors[3].b));
    initLight(3);
    delay(500);
    strip.setPixelColor(ledIndex[0], strip.Color(holoColors[10].r, holoColors[10].g, holoColors[10].b));
    initLight(0);
    delay(500);
    strip.setPixelColor(ledIndex[2], strip.Color(holoColors[2].r, holoColors[2].g, holoColors[2].b));
    initLight(2);
    delay(500);
    strip.setPixelColor(ledIndex[1], strip.Color(holoColors[7].r, holoColors[7].g, holoColors[7].b));
    initLight(1);
    delay(500);
    initLight(-1);
    //servo
    foldServo();
  }
}

int convSvData(int svdata) {
  if (svdata == 040) return 90;
  //currently, simply +58
  return map(svdata, 001, 077, SERVO_MIN_ANGLE, SERVO_MAX_ANGLE);
}

void send_key(uint16_t key) {
  ConsumerKeyboard.press(key);
  ConsumerKeyboard.release();
}

// Wi-Fiの接続情報を表示する関数
void printWifiStatus() {
  Serial.println("----------------------------------------");
  Serial.print("Connected to SSID: ");
  Serial.println(WiFi.SSID());

  // ルーターから割り当てられたIPアドレスを表示
  IPAddress ip = WiFi.localIP();
  Serial.print("IP Address: ");
  Serial.println(ip);
  Serial.println("----------------------------------------");
}

//--System Process Declaration--//

bool inPlaying = false;  //mode

uint16_t frame = 0;               //increment
unsigned long next_frame_us = 0;  //start us
unsigned long start = 0;

int servo_grad_fs = 0;

uint8_t curbri[LED_COUNT];  //current brightness
uint8_t curcol[LED_COUNT];  //current color
uint8_t curSvX[LED_COUNT];  //current servo X
uint8_t curSvY[LED_COUNT];  //current servo Y

//Buttons (by Gemini)
unsigned long buttonPressStartTime = 0;
bool buttonIsCurrentlyPressed = false;
const long longPressThreshold = 1000;
const long debounceDelay = 50;

void startPlayStaging(){
  //normal: start to play
  digitalWrite(13, LOW);
  inPlaying = true;
  frame = 0;
  delay(200);
  // Keyboard.write(' ');
  send_key(KEY_SCAN_PREVIOUS);
  delay(200);
  start = micros();
  send_key(KEY_PLAY_PAUSE);
  // Serial.println(micros() - s);
  // delayMicroseconds(500);
  delay(PLAY_DELAY);
  // Serial.println("start:"+String(micros()));
  Serial.println("start:" + String(millis()));
  // start = micros();
  next_frame_us = micros();
}

//--Setup--//

void setup() {
  Serial.begin(921600);
  Keyboard.begin();
  strip.begin();

  //hardware init
  pinMode(13, OUTPUT);
  pinMode(8, INPUT_PULLUP);
  digitalWrite(13, HIGH);

  initLight(-1);

  pwm.begin();
  pwm.setPWMFreq(50); //refresh 20000 us

  foldServo();

  servo_grad_fs = GRAD_FRAME / SERVO_GRAD_INT;

  //network init
  while (status != WL_CONNECTED) {
    Serial.print("Attempting to connect to SSID: ");
    Serial.println(ssid);
    status = WiFi.begin(ssid, pass);
    delay(2500); 
  }
  server.begin();
  printWifiStatus();
}

//--Process--//

void loop() {
  int sensorVal1 = digitalRead(BUTTON_PIN);

  //Todo: abort process (almost finished)

  if (inPlaying) {
    if (sensorVal1 == LOW && (micros() - start) > 1000000UL) {
      // Keyboard.write(' ');
      initLight(-1);
      initServo(-1);
      inPlaying = false;
      frame = 0;
      next_frame_us = 0;
      // send_key(KEY_SCAN_PREVIOUS);
      // send_key(KEY_PLAY_PAUSE);
      delay(200);
      digitalWrite(13, HIGH);
    } else {

      if (ENDFRAME > frame) {
        if (micros() >= next_frame_us) {
          // Serial.println("f" + String(frame) + " " + String(micros()) + "us");
          // Serial.println("f"+String(frame)+" "+String(millis())+"ms");
          //How many orders in the frame
          uint64_t lightOrder = light_frame_data[frame];
          uint64_t servoOrder = servo_frame_data[frame];
          if (frame >= ACTUAL_SIZE_OF_DATA) {
            lightOrder = 00ULL;
          }
          if (frame >= ACTUAL_SIZE_OF_SERVO_DATA) {
            servoOrder = 00ULL;
          }
          uint8_t pat = lightOrder & 07;
          uint8_t svpat = servoOrder & 07;
          //nol=number of light, col=color, bri=brightness, grad=gradation, ext=exist, lt=light, sv=servo
          //cur=current, tgt=target, ch=change(amount)

          //データを解釈整理→グラデーション有無の判定→即時データ反映→グラデーションデータ反映

          if (pat != 0x0 || svpat != 0x0) {
            bool extGrad = false;
            bool extLtGrad = false;
            bool extSvGrad = false;
            //以下配列は左埋めを予定（ライト番号indexと無関係）
            bool grads[4] = { false, false, false, false };
            bool svGrads[4] = { false, false, false, false };
            //light
            uint8_t tgtbri[4] = { 0, 0, 0, 0 };
            uint8_t tgtcol[4] = { 0, 0, 0, 0 };
            uint8_t tgtnol[4] = { 0, 0, 0, 0 };
            //servo
            uint8_t tgtSvY[4] = { 0, 0, 0, 0 };
            uint8_t tgtSvX[4] = { 0, 0, 0, 0 };
            uint8_t tgtSvnol[4] = { 0, 0, 0, 0 };

            //Light
            if (pat != 0x0) {
              if (00 < pat && pat < 05) {
                for (uint8_t o = 00; o < pat; o++) {
                  //No. col bri
                  //[7 77 77][][][][7]
                  uint8_t bri = ((lightOrder >> (3 + 15 * o)) & 077) * 4;
                  uint8_t col = (lightOrder >> (3 + 6 + 15 * o)) & 077;
                  uint8_t nol = (lightOrder >> (3 + 12 + 15 * o)) & 07;
                  if (nol < 4) {
                    //grad false
                    tgtbri[o] = bri;
                    tgtcol[o] = col;
                    tgtnol[o] = nol;
                  } else {
                    if (!extGrad) extGrad = true;
                    if (!extLtGrad) extLtGrad = true;
                    grads[o] = true;
                    tgtnol[o] = nol - 4;
                    tgtbri[o] = bri;
                    tgtcol[o] = col;
                  }
                }
              }
            }
            //Servo
            if (svpat != 0x0) {
              if (00 < svpat && svpat < 05) {
                for (uint8_t o = 00; o < svpat; o++) {
                  //No. svX svY
                  //[7 77 77][][][][7]
                  //生データを角度にマップ→角度の修正→setServoで角度をパルスにマップ反映
                  uint8_t svY = convSvData((servoOrder >> (3 + 15 * o)) & 077);
                  uint8_t svX = convSvData((servoOrder >> (3 + 6 + 15 * o)) & 077);
                  uint8_t svnol = (servoOrder >> (3 + 12 + 15 * o)) & 07;
                  if (svnol == 0 || svnol == 1 || svnol == 4 || svnol == 5) {  //OL,CL
                    svY = 180 - svY;
                  }
                  if (svnol < 4) {
                    //grad false
                    tgtSvY[o] = svY;
                    tgtSvX[o] = svX;
                    tgtSvnol[o] = svnol;
                  } else {
                    if (!extGrad) extGrad = true;
                    if (!extSvGrad) extSvGrad = true;
                    svGrads[o] = true;
                    tgtSvnol[o] = svnol - 4;
                    tgtSvY[o] = svY;
                    tgtSvX[o] = svX;
                  }
                }
              }
            }
            if (!extGrad) {  //Tidak ada gradation
              //Servo
              if (0 < svpat) {
                for (uint8_t o = 00; o < svpat; o++) {
                  int svnol = tgtSvnol[o];
                  int svX = tgtSvX[o];
                  int svY = tgtSvY[o];
                  curSvX[svnol] = svX;
                  curSvY[svnol] = svY;
                  setServo(servoX[svnol],svX);
                  setServo(servoY[svnol],svY);
                }
              }
              //Light
              if (0 < pat) {
                for (uint8_t o = 00; o < pat; o++) {
                  int nol = tgtnol[o];
                  int col = tgtcol[o];
                  int bri = tgtbri[o];
                  curbri[nol] = bri;
                  curcol[nol] = col;
                  strip.setPixelColor(ledIndex[nol], strip.Color(
                                             ((uint16_t)holoColors[col].r * bri) / MAX,
                                             ((uint16_t)holoColors[col].g * bri) / MAX,
                                             ((uint16_t)holoColors[col].b * bri) / MAX));
                }
                strip.show();
              }
            } else {
              short chbri[4] = { 0, 0, 0, 0 };
              short chcol[4][3] = { { 0, 0, 0 }, { 0, 0, 0 }, { 0, 0, 0 }, { 0, 0, 0 } };
              short chSvX[4] = { 0, 0, 0, 0 };
              short chSvY[4] = { 0, 0, 0, 0 };
              //st=start, grd=gradation, b=brightness, c=color
              uint8_t stgrdbri[4] = { 0, 0, 0, 0 };
              uint8_t stgrdcol[4] = { 0, 0, 0, 0 };
              uint8_t stgrdSvX[4] = { 0, 0, 0, 0 };
              uint8_t stgrdSvY[4] = { 0, 0, 0, 0 };
              if (extLtGrad) {
                for (uint8_t o = 00; o < pat; o++) {
                  if (!grads[o]) continue;
                  chbri[o] = tgtbri[o] - curbri[tgtnol[o]];
                  chcol[o][0] = ((short)holoColors[tgtcol[o]].r - holoColors[curcol[tgtnol[o]]].r);
                  chcol[o][1] = ((short)holoColors[tgtcol[o]].g - holoColors[curcol[tgtnol[o]]].g);
                  chcol[o][2] = ((short)holoColors[tgtcol[o]].b - holoColors[curcol[tgtnol[o]]].b);
                  stgrdbri[tgtnol[o]] = curbri[tgtnol[o]];
                  stgrdcol[tgtnol[o]] = curcol[tgtnol[o]];
                  curbri[tgtnol[o]] = tgtbri[o];
                  curcol[tgtnol[o]] = tgtcol[o];
                }
              }
              if (extSvGrad) {
                for (uint8_t o = 00; o < svpat; o++) {
                  if (!svGrads[o]) continue;
                  chSvX[o] = tgtSvX[o] - curSvX[tgtSvnol[o]];
                  chSvY[o] = tgtSvY[o] - curSvY[tgtSvnol[o]];
                  stgrdSvX[tgtSvnol[o]] = curSvX[tgtSvnol[o]];
                  stgrdSvY[tgtSvnol[o]] = curSvY[tgtSvnol[o]];
                  curSvX[tgtSvnol[o]] = tgtSvX[o];
                  curSvY[tgtSvnol[o]] = tgtSvY[o];
                }
              }
              // uint32_t s = micros();
              // Serial.println("grad start: " + s);
              int sf = 1;
              for (int f = 1; f <= GRAD_FRAME; f++) {
                if (extSvGrad) {
                  if ((f - 1) % SERVO_GRAD_INT == 0) {
                    for (uint8_t o = 00; o < svpat; o++) {
                      if (!svGrads[o]) continue;
                      uint8_t setSvX = ((uint16_t)stgrdSvX[tgtSvnol[o]] + ((chSvX[o] * sf) / servo_grad_fs));
                      uint8_t setSvY = ((uint16_t)stgrdSvY[tgtSvnol[o]] + ((chSvY[o] * sf) / servo_grad_fs));
                      setServo(servoX[tgtSvnol[o]],setSvX);
                      setServo(servoY[tgtSvnol[o]],setSvY);
                    }
                    sf++;
                  }
                }
                if (extLtGrad) {
                  for (uint8_t o = 00; o < pat; o++) {
                    if (!grads[o]) continue;
                    uint8_t setbri = ((uint16_t)stgrdbri[tgtnol[o]] + ((chbri[o] * f) / GRAD_FRAME));
                    Rgb setcol = { 0, 0, 0 };
                    setcol.r = ((uint16_t)holoColors[stgrdcol[tgtnol[o]]].r + ((chcol[o][0] * f) / GRAD_FRAME));
                    setcol.g = ((uint16_t)holoColors[stgrdcol[tgtnol[o]]].g + ((chcol[o][1] * f) / GRAD_FRAME));
                    setcol.b = ((uint16_t)holoColors[stgrdcol[tgtnol[o]]].b + ((chcol[o][2] * f) / GRAD_FRAME));
                    strip.setPixelColor(ledIndex[tgtnol[o]], strip.Color(
                                                     ((uint16_t)setcol.r * setbri) / MAX,
                                                     ((uint16_t)setcol.g * setbri) / MAX,
                                                     ((uint16_t)setcol.b * setbri) / MAX));
                  }
                  strip.show();
                }
              }
              // Serial.println("grad end: " + String(micros()) + ", time: " + String(micros() - s) + "us");
            }
          }
          frame++;
          next_frame_us += FRAME_RATE;
        }
      } else {
        send_key(KEY_PLAY_PAUSE);
        inPlaying = false;
        initLight(-1);
        initServo(-1);
      }
    }
  } else {
    WiFiClient client = server.available();

    //button process by Gemini
    if (sensorVal1 == LOW && !buttonIsCurrentlyPressed) {
      buttonPressStartTime = millis();
      buttonIsCurrentlyPressed = true;
    }

    //button process by Gemini
    if (sensorVal1 == HIGH && buttonIsCurrentlyPressed) {
      unsigned long pressDuration = millis() - buttonPressStartTime;
      buttonIsCurrentlyPressed = false;

      if (pressDuration < debounceDelay) {
        //ignore: chattering
      } else if (pressDuration >= longPressThreshold) {
        //long press: system boot
        if (!isSystemBooted) {
          bootdownAnimation(true);
          isSystemBooted = true;
        }else{
          bootdownAnimation(false);
          isSystemBooted = false;
        }
      } else {
        //normal: start to play
        startPlayStaging();
      }
    }

    if (sensorVal1 == HIGH && !buttonIsCurrentlyPressed) {
      delay(50);
    }

    if (client) {
      String requestLine = "";
      String requestBody = "";
      boolean isPost = false;
      boolean currentLineIsBlank = true;
      boolean isBody = false;

      while (client.connected()) {
        //---Hardware loop code---//

        //--hardware-end--//

        if (client.available()) {
          char c = client.read();
          
          // リクエストの最初の数文字を保存してGETかPOSTか判定
          if (requestLine.length() < 10) {
            requestLine += c;
          }

          // 改行コード(\n)が来て、かつその行が空行だった場合、ヘッダーの終了
          if (c == '\n' && currentLineIsBlank) {
            isBody = true;
            if (requestLine.startsWith("POST")) {
              isPost = true;
            }
          }

          // 空行の判定ロジック
          if (c == '\n') {
            currentLineIsBlank = true;
          } else if (c != '\r') {
            currentLineIsBlank = false;
          }

          // ヘッダー終了後、POSTメソッドであればボディを読み取る
          if (isBody && isPost && client.available()) {
            while(client.available()) {
              requestBody += (char)client.read();
            }
            
            Serial.println("Received: " + requestBody);

            // Unityからのデータに応じてスイッチを切り替え
            if (requestBody.indexOf("PLAY") >= 0) {
              /////
              Serial.println("Play by ext");
              delay(850);
              startPlayStaging();
            }/* else if (requestBody.indexOf("OFF") >= 0) {
              digitalWrite(switchPin, LOW);
              //////
              Serial.println("-> Switch OFF");
            }*/
            
            // Unityへレスポンスを返す
            client.println("HTTP/1.1 200 OK");
            client.println("Content-Type: text/plain");
            client.println("Connection: close");
            client.println();
            client.println("Arduino R4: Command Received");
            break;
          }
          
          // POST以外（ブラウザからのアクセスなど）への対応
          if (isBody && !isPost) {
              client.println("HTTP/1.1 200 OK");
              client.println("Content-Type: text/html");
              client.println("Connection: close");
              client.println();
              client.println("<html><body><h1>Arduino UNO R4 WiFi Server is Running</h1></body></html>");
              break;
          }
        }
      }
      delay(1);
      client.stop();
    }
  }
}
